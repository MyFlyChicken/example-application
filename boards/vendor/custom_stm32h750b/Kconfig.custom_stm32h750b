## boards/vendor/custom_stm32h750b/Kconfig.custom_stm32h750b
```kconfig
# Copyright (c) 2023 STMicroelectronics
# SPDX-License-Identifier: Apache-2.0

config BOARD_CUSTOM_STM32H750B
	select SOC_STM32H750XX
```

## boards/vendor/custom_stm32h750b/board.yml
```yaml
board:
  name: custom_stm32h750b
  full_name: STM32H750B develop plank buy of TaOBao 
  vendor: st
  socs:
    - name: stm32h750xx
```
